/**
 * @file ota.cpp
 * @brief HTTP OTA firmware update implementation.
 *
 * Routes:
 *   GET  /ota  — serves a minimal HTML upload form
 *   POST /ota  — receives multipart firmware binary and flashes it
 *
 * The upload runs inside ESPAsyncWebServer's lwIP TCPIP task (Core 0);
 * the Arduino loop on Core 1 is never blocked.
 *
 * The Arduino Update library wraps the ESP-IDF esp_ota API, handling
 * partition selection, sequential writes, image validation, and the
 * boot-partition switch atomically before the reboot.
 */

#ifdef ARDUINO

#include <Arduino.h>
#include <Update.h>
#include <ESPAsyncWebServer.h>
#include <esp_ota_ops.h>  // includes esp_app_desc_t; esp_ota_get_app_description()
                          // was added in IDF 5.2 — use esp_ota_get_app_description()
                          // for compatibility with IDF 5.1.x (espressif32 ≤ 6.x)
#include <nvs.h>          // nvs_open / nvs_get_i64 / nvs_set_i64 / nvs_commit / nvs_close
#include <time.h>         // time(), strftime(), localtime()

#include "ota.h"
#include "config.h"
#include "state_machine.h"
#include "web_content.h"  // provides ota_html — generated by scripts/embed_web.py from data/ota.html

namespace ota {

// ─── Module state ──────────────────────────────────────────────────────────────

static Status   s_status               = Status::IDLE;
static char     s_lastError[96]        = "";
static bool     s_rebootPending        = false;
static int64_t  s_lastFlashTime        = 0;   ///< Unix epoch of last successful OTA flash (0 = never)

// ─── Internal helpers ─────────────────────────────────────────────────────────

/** Spawn a task that waits @p delayMs then calls esp_restart(). */
static void scheduleReboot(uint32_t delayMs) {
    struct RebootArgs {
        uint32_t delayMs;
    };
    // Allocate on heap; the task frees it before exiting.
    auto* args = static_cast<RebootArgs*>(pvPortMalloc(sizeof(RebootArgs)));
    if (!args) {
        // Fallback: reboot immediately if allocation fails.
        esp_restart();
        return;
    }
    args->delayMs = delayMs;

    xTaskCreate(
        [](void* arg) {
            const auto* a = static_cast<RebootArgs*>(arg);
            vTaskDelay(pdMS_TO_TICKS(a->delayMs));
            vPortFree(arg);
            esp_restart();
            vTaskDelete(nullptr);
        },
        "ota_reboot",
        1024,
        args,
        tskIDLE_PRIORITY + 5,
        nullptr
    );
}

// ─── Upload handler ────────────────────────────────────────────────────────────
//
// Called by ESPAsyncWebServer for each chunk of the multipart upload.
// Runs in the TCPIP task (Core 0) — keep it fast; avoid Serial output in
// the hot path (Update.write is already the bottleneck at ~1 MB/s on WiFi).

static void handleUploadChunk(
    AsyncWebServerRequest* /*request*/,
    const String& /*filename*/,
    size_t        index,
    uint8_t*      data,
    size_t        len,
    bool          final)
{
    // ── First chunk ───────────────────────────────────────────────────────────
    if (index == 0) {
        // Reject if the cryocooler is actively running.
        if (state_machine::isRunning()) {
            snprintf(s_lastError, sizeof(s_lastError),
                     "System is running (%s) — stop before updating firmware",
                     state_machine::stateName(state_machine::getState()));
            s_status = Status::FAILED;
            Serial.printf("[ota] Upload rejected: %s\n", s_lastError);
            return;
        }

        // Reset state from any previous attempt.
        s_status       = Status::IDLE;
        s_lastError[0] = '\0';

        Serial.println(F("[ota] OTA update started"));

        // UPDATE_SIZE_UNKNOWN causes the Update library to size the partition
        // dynamically; U_FLASH selects the next OTA app slot.
        if (!Update.begin(UPDATE_SIZE_UNKNOWN, U_FLASH)) {
            Update.printError(Serial);
            // getErrorString() returns a flash-string pointer — copy to RAM.
            snprintf(s_lastError, sizeof(s_lastError),
                     "Update.begin failed: %s", Update.errorString());
            s_status = Status::FAILED;
            return;
        }

        s_status = Status::IN_PROGRESS;
    }

    // ── Guard against writing after an error ──────────────────────────────────
    if (s_status != Status::IN_PROGRESS) {
        return;
    }

    // ── Write chunk ───────────────────────────────────────────────────────────
    if (len > 0) {
        const size_t written = Update.write(data, len);
        if (written != len) {
            snprintf(s_lastError, sizeof(s_lastError),
                     "Update.write underrun: wrote %u of %u bytes",
                     static_cast<unsigned>(written),
                     static_cast<unsigned>(len));
            s_status = Status::FAILED;
            Update.abort();
            Serial.printf("[ota] Write error: %s\n", s_lastError);
            return;
        }
    }

    // ── Final chunk ───────────────────────────────────────────────────────────
    if (final) {
        if (Update.end(true)) {  // true = set boot partition
            s_status        = Status::SUCCESS;
            s_rebootPending = true;

            // Persist the flash timestamp so the dashboard can show it after reboot.
            // time() returns 0 when SNTP has not yet synced — we store it anyway
            // so the UI can display "not synced" rather than "never updated".
            const int64_t ts = static_cast<int64_t>(time(nullptr));
            nvs_handle_t nvs;
            if (nvs_open("ota", NVS_READWRITE, &nvs) == ESP_OK) {
                nvs_set_i64(nvs, "flash_ts", ts);
                nvs_commit(nvs);
                nvs_close(nvs);
            }
            s_lastFlashTime = ts;

            Serial.println(F("[ota] Update complete — rebooting in 500 ms"));
        } else {
            snprintf(s_lastError, sizeof(s_lastError),
                     "Update.end failed: %s", Update.errorString());
            s_status = Status::FAILED;
            Serial.printf("[ota] Finalise error: %s\n", s_lastError);
        }
    }
}

// ─── Response handler ─────────────────────────────────────────────────────────
//
// Called by ESPAsyncWebServer after the entire upload body has been processed.
// Sends the outcome to the browser, then triggers a reboot if the flash succeeded.

static void handleResponse(AsyncWebServerRequest* request) {
    if (s_status == Status::SUCCESS) {
        request->send(200, "text/plain",
                      "OK: firmware flashed. Rebooting in 500 ms…");
        scheduleReboot(500);
    } else if (s_status == Status::FAILED) {
        char body[128];
        snprintf(body, sizeof(body), "ERR: %s", s_lastError);
        request->send(400, "text/plain", body);
        // Reset to IDLE so the user can retry.
        s_status = Status::IDLE;
    } else {
        // Unexpected state (e.g. empty upload).
        request->send(400, "text/plain", "ERR: no data received");
    }
}

// ─── Public API ───────────────────────────────────────────────────────────────

module::InitStatus init() {
#if !ENABLE_OTA
    Serial.println(F("[ota] OTA disabled in config.h"));
    return module::MODULE_INIT_SUCCESS;
#endif

    // Verify the running partition table has an OTA update target.
    const esp_partition_t* next = esp_ota_get_next_update_partition(nullptr);
    if (next == nullptr) {
        Serial.println(F("[ota] ERROR: no OTA partition found — "
                         "check board_build.partitions in platformio.ini"));
        return module::MODULE_INIT_CONFIG_ERROR;
    }

    // Load the last OTA flash timestamp from NVS so it survives reboots.
    {
        nvs_handle_t nvs;
        if (nvs_open("ota", NVS_READONLY, &nvs) == ESP_OK) {
            int64_t ts = 0;
            if (nvs_get_i64(nvs, "flash_ts", &ts) == ESP_OK) {
                s_lastFlashTime = ts;
            }
            nvs_close(nvs);
        }
    }

    const esp_partition_t* running = esp_ota_get_running_partition();
    const esp_app_desc_t*  desc    = esp_ota_get_app_description();

    Serial.printf("[ota] Running partition : %s (subtype 0x%02x)\n",
                  running ? running->label : "?",
                  running ? running->subtype : 0u);
    Serial.printf("[ota] Next update target: %s\n", next->label);
    Serial.printf("[ota] Firmware version  : %s  built %s %s\n",
                  desc->version, desc->date, desc->time);
    Serial.printf("[ota] Update endpoint   : http://%s/ota\n", HOSTNAME);

    return module::MODULE_INIT_SUCCESS;
}

module::ServiceStatus service() {
    return module::MODULE_SERVICE_SKIPPED;
}

void registerRoutes(AsyncWebServer& server) {
#if !ENABLE_OTA
    return;
#endif

    // Static assets — all three symbols come from web_content.h, generated
    // by scripts/embed_web.py from the source files in data/ at build time.
    server.on("/ota", HTTP_GET, [](AsyncWebServerRequest* request) {
        request->send(200, "text/html",                ota_html);
    });
    server.on("/ota.css", HTTP_GET, [](AsyncWebServerRequest* request) {
        request->send(200, "text/css",                 ota_css);
    });
    server.on("/ota.js", HTTP_GET, [](AsyncWebServerRequest* request) {
        request->send(200, "application/javascript",   ota_js);
    });

    // POST /ota — firmware binary upload
    server.on(
        "/ota",
        HTTP_POST,
        handleResponse,    // called once after the upload completes
        handleUploadChunk  // called for every chunk of the multipart body
    );

    Serial.println(F("[ota] Routes registered: GET /ota  /ota.css  /ota.js  POST /ota"));
}

Status      getStatus()      { return s_status; }
bool        isInProgress()   { return s_status == Status::IN_PROGRESS; }
bool        isSuccess()      { return s_status == Status::SUCCESS; }
const char* getLastError()   { return s_lastError; }
int64_t     getLastFlashTime() { return s_lastFlashTime; }

const char* getFirmwareVersion() {
    return esp_ota_get_app_description()->version;
}

const char* getFirmwareBuildDate() {
    // Static buffer — safe because this is only read from HTTP callbacks and
    // the telemetry task, both of which run serialised in the TCPIP task.
    static char buf[32];
    const esp_app_desc_t* d = esp_ota_get_app_description();
    snprintf(buf, sizeof(buf), "%s %s", d->date, d->time);
    return buf;
}

const char* getStatusText() {
    switch (s_status) {
        case Status::IDLE:        return "idle";
        case Status::IN_PROGRESS: return "in progress";
        case Status::SUCCESS:     return "success";
        case Status::FAILED:      return "failed";
        default:                  return "unknown";
    }
}

} // namespace ota

#endif // ARDUINO
